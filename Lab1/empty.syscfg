/**
 * These arguments were used when this file was generated. They will be automatically applied on subsequent loads
 * via the GUI or CLI. Run CLI with '--help' for additional information on how to override these arguments.
 * @cliArgs --device "MSPM0G350X" --part "Default" --package "LQFP-64(PM)" --product "mspm0_sdk@2.11.00.07"
 * @v2CliArgs --device "MSPM0G3507" --package "LQFP-64(PM)" --product "mspm0_sdk@2.11.00.07"
 * @versions {"tool":"1.26.2+4477"}
 */

/**
 * Import the modules used in this configuration.
 */
const GPIO   = scripting.addModule("/ti/driverlib/GPIO", {}, false);
const GPIO1  = GPIO.addInstance();
const GPIO2  = GPIO.addInstance();
const GPIO3  = GPIO.addInstance();
const I2C    = scripting.addModule("/ti/driverlib/I2C", {}, false);
const I2C1   = I2C.addInstance();
const SYSCTL = scripting.addModule("/ti/driverlib/SYSCTL");
const TIMER  = scripting.addModule("/ti/driverlib/TIMER", {}, false);
const TIMER1 = TIMER.addInstance();

/**
 * Write custom configuration values to the imported modules.
 */
GPIO1.$name                          = "GPIO_GRP_0";
GPIO1.associatedPins.create(7);
GPIO1.associatedPins[0].$name        = "PIN_RS";
GPIO1.associatedPins[0].assignedPort = "PORTB";
GPIO1.associatedPins[0].assignedPin  = "20";
GPIO1.associatedPins[1].assignedPort = "PORTA";
GPIO1.associatedPins[1].assignedPin  = "22";
GPIO1.associatedPins[1].$name        = "PIN_D6";
GPIO1.associatedPins[2].$name        = "PIN_RW";
GPIO1.associatedPins[2].assignedPort = "PORTA";
GPIO1.associatedPins[2].assignedPin  = "31";
GPIO1.associatedPins[3].$name        = "PIN_EN";
GPIO1.associatedPins[3].assignedPort = "PORTA";
GPIO1.associatedPins[3].assignedPin  = "28";
GPIO1.associatedPins[4].$name        = "PIN_D4";
GPIO1.associatedPins[4].assignedPort = "PORTB";
GPIO1.associatedPins[4].assignedPin  = "16";
GPIO1.associatedPins[5].$name        = "PIN_D5";
GPIO1.associatedPins[5].assignedPort = "PORTB";
GPIO1.associatedPins[5].assignedPin  = "17";
GPIO1.associatedPins[6].$name        = "PIN_D7";
GPIO1.associatedPins[6].assignedPort = "PORTB";
GPIO1.associatedPins[6].assignedPin  = "19";

const Board = scripting.addModule("/ti/driverlib/Board", {}, false);

GPIO2.$name                              = "GG_OCTO";
GPIO2.associatedPins.create(2);
GPIO2.associatedPins[0].$name            = "OCTOLEFT";
GPIO2.associatedPins[0].assignedPort     = "PORTB";
GPIO2.associatedPins[0].direction        = "INPUT";
GPIO2.associatedPins[0].internalResistor = "PULL_UP";
GPIO2.associatedPins[0].interruptEn      = true;
GPIO2.associatedPins[0].polarity         = "RISE_FALL";
GPIO2.associatedPins[0].assignedPin      = "7";
GPIO2.associatedPins[1].$name            = "OCTORIGHT";
GPIO2.associatedPins[1].direction        = "INPUT";
GPIO2.associatedPins[1].assignedPort     = "PORTB";
GPIO2.associatedPins[1].internalResistor = "PULL_UP";
GPIO2.associatedPins[1].interruptEn      = true;
GPIO2.associatedPins[1].polarity         = "RISE_FALL";
GPIO2.associatedPins[1].assignedPin      = "8";

GPIO3.$name                          = "GPIO_GRP_1";
GPIO3.associatedPins.create(9);
GPIO3.associatedPins[0].$name        = "SEG_A_PIN";
GPIO3.associatedPins[0].assignedPort = "PORTA";
GPIO3.associatedPins[0].assignedPin  = "8";
GPIO3.associatedPins[1].$name        = "SEG_B_PIN";
GPIO3.associatedPins[1].assignedPort = "PORTB";
GPIO3.associatedPins[1].assignedPin  = "24";
GPIO3.associatedPins[2].$name        = "SEG_C_PIN";
GPIO3.associatedPins[2].assignedPort = "PORTB";
GPIO3.associatedPins[2].assignedPin  = "18";
GPIO3.associatedPins[3].$name        = "SEG_D_PIN";
GPIO3.associatedPins[3].assignedPort = "PORTA";
GPIO3.associatedPins[3].assignedPin  = "18";
GPIO3.associatedPins[4].$name        = "SEG_E_PIN";
GPIO3.associatedPins[4].assignedPort = "PORTA";
GPIO3.associatedPins[4].assignedPin  = "24";
GPIO3.associatedPins[5].assignedPort = "PORTB";
GPIO3.associatedPins[5].assignedPin  = "15";
GPIO3.associatedPins[5].$name        = "SEG_G_PIN";
GPIO3.associatedPins[6].$name        = "SEG_F_PIN";
GPIO3.associatedPins[6].assignedPort = "PORTA";
GPIO3.associatedPins[6].assignedPin  = "17";
GPIO3.associatedPins[7].$name        = "SEV_SEG_1";
GPIO3.associatedPins[7].assignedPort = "PORTA";
GPIO3.associatedPins[7].assignedPin  = "15";
GPIO3.associatedPins[8].$name        = "SEV_SEG_2";
GPIO3.associatedPins[8].assignedPort = "PORTA";
GPIO3.associatedPins[8].assignedPin  = "25";

I2C1.$name              = "I2C_0";
I2C1.sdaPinConfig.$name = "ti_driverlib_gpio_GPIOPinGeneric0";
I2C1.sclPinConfig.$name = "ti_driverlib_gpio_GPIOPinGeneric1";

SYSCTL.forceDefaultClkConfig = true;

TIMER1.$name            = "TIMER_0";
TIMER1.timerMode        = "PERIODIC";
TIMER1.interrupts       = ["ZERO"];
TIMER1.timerStartTimer  = true;
TIMER1.timerClkDiv      = 8;
TIMER1.timerClkPrescale = 64;
TIMER1.timerPeriod      = "8.33 ms";

/**
 * Pinmux solution for unlocked pins/peripherals. This ensures that minor changes to the automatic solver in a future
 * version of the tool will not impact the pinmux you originally saw.  These lines can be completely deleted in order to
 * re-solve from scratch.
 */
GPIO1.associatedPins[0].pin.$suggestSolution = "PB20";
GPIO1.associatedPins[1].pin.$suggestSolution = "PA22";
GPIO1.associatedPins[2].pin.$suggestSolution = "PA31";
GPIO1.associatedPins[3].pin.$suggestSolution = "PA28";
GPIO1.associatedPins[4].pin.$suggestSolution = "PB16";
GPIO1.associatedPins[5].pin.$suggestSolution = "PB17";
GPIO1.associatedPins[6].pin.$suggestSolution = "PB19";
Board.peripheral.$suggestSolution            = "DEBUGSS";
Board.peripheral.swclkPin.$suggestSolution   = "PA20";
Board.peripheral.swdioPin.$suggestSolution   = "PA19";
GPIO2.associatedPins[0].pin.$suggestSolution = "PB7";
GPIO2.associatedPins[1].pin.$suggestSolution = "PB8";
GPIO3.associatedPins[0].pin.$suggestSolution = "PA8";
GPIO3.associatedPins[1].pin.$suggestSolution = "PB24";
GPIO3.associatedPins[2].pin.$suggestSolution = "PB18";
GPIO3.associatedPins[3].pin.$suggestSolution = "PA18";
GPIO3.associatedPins[4].pin.$suggestSolution = "PA24";
GPIO3.associatedPins[5].pin.$suggestSolution = "PB15";
GPIO3.associatedPins[6].pin.$suggestSolution = "PA17";
GPIO3.associatedPins[7].pin.$suggestSolution = "PA15";
GPIO3.associatedPins[8].pin.$suggestSolution = "PA25";
I2C1.peripheral.$suggestSolution             = "I2C0";
I2C1.peripheral.sdaPin.$suggestSolution      = "PA0";
I2C1.peripheral.sclPin.$suggestSolution      = "PA1";
SYSCTL.peripheral.$suggestSolution           = "SYSCTL";
TIMER1.peripheral.$suggestSolution           = "TIMA0";