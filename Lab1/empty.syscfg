/**
 * @cliArgs --device "MSPM0G350X" --part "Default" --package "LQFP-64(PM)" --product "mspm0_sdk@2.11.00.07"
 * @versions {"tool":"1.26.2+4477"}
 */

/**
 * Import the modules used in this configuration.
 */
const GPIO   = scripting.addModule("/ti/driverlib/GPIO", {}, false);
const GPIO1  = GPIO.addInstance();
const I2C    = scripting.addModule("/ti/driverlib/I2C", {}, false);
const I2C1   = I2C.addInstance();
const SYSCTL = scripting.addModule("/ti/driverlib/SYSCTL");
const TIMER  = scripting.addModule("/ti/driverlib/TIMER", {}, false);
const TIMER1 = TIMER.addInstance();
// LAB 7.2.3 - Servo PWM
const PWM  = scripting.addModule("/ti/driverlib/PWM", {}, false);
const PWM1 = PWM.addInstance();

/**
 * Write custom configuration values to the imported modules.
 */
GPIO1.$name                          = "GPIO_GRP_0";
GPIO1.associatedPins.create(5);
GPIO1.associatedPins[0].assignedPort = "PORTA";
GPIO1.associatedPins[0].assignedPin  = "8";
GPIO1.associatedPins[0].$name        = "HB_IN2";
GPIO1.associatedPins[0].direction    = "OUTPUT";
GPIO1.associatedPins[1].$name        = "HB_IN1";
GPIO1.associatedPins[1].direction    = "OUTPUT";
GPIO1.associatedPins[1].assignedPort = "PORTB";
GPIO1.associatedPins[1].assignedPin  = "9";
GPIO1.associatedPins[2].$name        = "IN_0";
GPIO1.associatedPins[2].direction    = "INPUT";
GPIO1.associatedPins[2].assignedPort = "PORTB";
GPIO1.associatedPins[2].assignedPin  = "7";
GPIO1.associatedPins[3].$name        = "IN_1";
GPIO1.associatedPins[3].direction    = "INPUT";
GPIO1.associatedPins[3].assignedPort = "PORTB";
GPIO1.associatedPins[3].assignedPin  = "6";
GPIO1.associatedPins[4].$name            = "IN_2";
GPIO1.associatedPins[4].direction        = "INPUT";
GPIO1.associatedPins[4].internalResistor = "PULL_UP";
GPIO1.associatedPins[4].assignedPort     = "PORTB";
GPIO1.associatedPins[4].assignedPin      = "21";

const Board = scripting.addModule("/ti/driverlib/Board", {}, false);

I2C1.$name              = "I2C_0";
I2C1.sdaPinConfig.$name = "ti_driverlib_gpio_GPIOPinGeneric0";
I2C1.sclPinConfig.$name = "ti_driverlib_gpio_GPIOPinGeneric1";

SYSCTL.forceDefaultClkConfig = true;

TIMER1.$name            = "TIMER_0";
TIMER1.timerMode        = "PERIODIC";
TIMER1.interrupts       = ["ZERO"];
TIMER1.timerClkDiv      = 8;
TIMER1.timerClkPrescale = 64;
TIMER1.timerPeriod      = "0.05ms";


/*========== LAB 7.2.3 - SERVO MOTOR ==========*/

PWM1.$name = "PWM";

// PWM on TIMA1 Channel 0
PWM1.ccIndex = [0];

// Edge-aligned PWM
PWM1.pwmMode = "EDGE_ALIGN";

// 32 MHz / 8 / 4 = 1 MHz
PWM1.clockDivider = 8;
PWM1.clockPrescale = 4;

// 20,000 counts = 20 ms = 50 Hz
PWM1.timerCount = 20000;

// C code starts the timer
PWM1.timerStartTimer = false;

// Initial position: approximately 90 degrees
PWM1.PWM_CHANNEL_0.$name =
    "ti_driverlib_pwm_PWMTimerCC0";

PWM1.PWM_CHANNEL_0.dutyCycle = 7.5;

// Servo signal output
PWM1.peripheral.$assign = "TIMA1";
PWM1.peripheral.ccp0Pin.$assign = "PB4";


/**
 * Pinmux solution for unlocked pins/peripherals. This ensures that minor changes to the automatic solver in a future
 * version of the tool will not impact the pinmux you originally saw.  These lines can be completely deleted in order to
 * re-solve from scratch.
 */
GPIO1.associatedPins[0].pin.$suggestSolution = "PA8";
GPIO1.associatedPins[1].pin.$suggestSolution = "PB9";
GPIO1.associatedPins[2].pin.$suggestSolution = "PB7";
GPIO1.associatedPins[3].pin.$suggestSolution = "PB6";
GPIO1.associatedPins[4].pin.$suggestSolution = "PB21";
Board.peripheral.$suggestSolution            = "DEBUGSS";
Board.peripheral.swclkPin.$suggestSolution   = "PA20";
Board.peripheral.swdioPin.$suggestSolution   = "PA19";
I2C1.peripheral.$suggestSolution             = "I2C0";
I2C1.peripheral.sdaPin.$suggestSolution      = "PA0";
I2C1.peripheral.sclPin.$suggestSolution      = "PA1";
SYSCTL.peripheral.$suggestSolution           = "SYSCTL";
TIMER1.peripheral.$suggestSolution           = "TIMA0";
